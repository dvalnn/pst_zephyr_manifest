## west.yml
```yaml
manifest:
  remotes:
    - name: zephyrproject-rtos
      url-base: https://github.com/zephyrproject-rtos
    - name: dvalnn
      url-base: https://github.com/dvalnn
    - name: Lora-net
      url-base: https://github.com/Lora-net
  defaults:
    remote:  dvalnn

  projects:
    - name: zephyr
      remote: zephyrproject-rtos
      revision: v4.1.0
      import: true

    #NOTE: The semtech LBM_Zephyr repo is broken and does not build
    #      We may need to fork it and fix it in the future, if needed
    # - name: LBM_zephyr
    #   remote: Lora-net
    #   revision: master
    #   import: true

    - name: invictus-zephyr
      revision: main

  self:
    path: pst_zephyr_manifest
```
